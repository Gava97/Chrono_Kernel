## drivers/pinctrl/Kconfig
```kconfig
#
# PINCTRL infrastructure and drivers
#

menuconfig PINCTRL
	bool "PINCTRL Support"
	depends on SYSFS && EXPERIMENTAL
	help
	  This enables the PINCTRL subsystem for controlling pins
	  on chip packages, for example multiplexing pins on primarily
	  PGA and BGA packages for systems on chip.

	  If unsure, say N.

if PINCTRL

config PINMUX
        bool "Support pinmux controllers"

config DEBUG_PINCTRL
        bool "Debug PINCTRL calls"
        depends on DEBUG_KERNEL
        help
          Say Y here to add some extra checks and diagnostics to PINCTRL calls.

config PINMUX_SIRF
        bool "CSR SiRFprimaII pinmux driver"
        depends on ARCH_PRIMA2
        select PINMUX

config PINMUX_U300
        bool "U300 pinmux driver"
        depends on ARCH_U300
        select PINMUX

endif
```

## drivers/staging/hv/Kconfig
```kconfig
config HYPERV_STORAGE
	tristate "Microsoft Hyper-V virtual storage driver"
	depends on HYPERV && SCSI
	help
	 Select this option to enable the Hyper-V virtual storage driver.

config HYPERV_BLOCK
	tristate "Microsoft Hyper-V virtual block driver"
	depends on BLOCK && SCSI && (LBDAF || 64BIT)
	default HYPERV
	help
	  Select this option to enable the Hyper-V virtual block driver.

config HYPERV_NET
	tristate "Microsoft Hyper-V virtual network driver"
	depends on HYPERV && NET
	help
	  Select this option to enable the Hyper-V virtual network driver.

config HYPERV_MOUSE
	tristate "Microsoft Hyper-V mouse driver"
	depends on HYPERV && HID
	help
	  Select this option to enable the Hyper-V mouse driver.
```
